## sdkconfig.defaults.template
```kconfig
# ESP-IDF settings
CONFIG_IDF_TARGET="esp32s3"

# WIFI EXAMPLE settings
CONFIG_EXAMPLE_WIFI_SSID=""
CONFIG_EXAMPLE_WIFI_PASSWORD=""
ESP_WIFI_TASK_CORE_ID=1

# Use predefined partition tables
CONFIG_PARTITION_TABLE_CUSTOM=y

# Enable MQTT5 protocol support
CONFIG_MQTT_PROTOCOL_5=y

# Other MQTT configurations
# CONFIG_MQTT_TRANSPORT_SSL=y
# CONFIG_MQTT_TRANSPORT_WEBSOCKET=y
# CONFIG_MQTT_TRANSPORT_WEBSOCKET_SECURE=y

# MQTT TASK configurations
MQTT_TASK_CORE_SELECTION_ENABLED=y
MQTT_TASK_CORE_SELECTION=1

# Flash Configuration
CONFIG_ESPTOOLPY_FLASHMODE_QIO=y
CONFIG_ESPTOOLPY_FLASHFREQ_80M=y
CONFIG_ESPTOOLPY_FLASHSIZE_16MB=y

# PSRAM Configuration (8MB Octal PSRAM)
CONFIG_SPIRAM=y
CONFIG_SPIRAM_MODE_OCT=y
CONFIG_SPIRAM_SPEED_80M=y
CONFIG_SPIRAM_SIZE=8388608
CONFIG_SPIRAM_FETCH_INSTRUCTIONS=y
CONFIG_SPIRAM_RODATA=y

# Memory Optimization
CONFIG_COMPILER_OPTIMIZATION_PERF=y

# CPU Configuration
CONFIG_ESP_DEFAULT_CPU_FREQ_MHZ_240=y

# Hardware Acceleration
CONFIG_ESP32S3_INSTRUCTION_CACHE_32KB=y
CONFIG_ESP32S3_DATA_CACHE_64KB=y
CONFIG_ESP32S3_DATA_CACHE_LINE_64B=y

# Wi-Fi Performance Optimizations
CONFIG_ESP_WIFI_DYNAMIC_RX_BUFFER_NUM=64
CONFIG_ESP_WIFI_DYNAMIC_TX_BUFFER=y
CONFIG_ESP_WIFI_TX_BA_WIN=32
CONFIG_ESP_WIFI_RX_BA_WIN=32
CONFIG_ESP_WIFI_STATIC_RX_BUFFER_NUM=16

# Bluetooth LE 5.0 Optimizations
CONFIG_BT_ENABLED=y
CONFIG_BT_NIMBLE_ENABLED=y
CONFIG_BTDM_CTRL_MODE_BLE_ONLY=y
CONFIG_BT_NIMBLE_MAX_CONNECTIONS=5

# GPIO and Peripheral Optimizations
CONFIG_GPIO_ESP32S3_SUPPORT_RTCIO=y
CONFIG_GPIO_CTRL_FUNC_IN_IRAM=y

# FreeRTOS Task and Interrupt Optimizations
CONFIG_FREERTOS_HZ=1000
CONFIG_FREERTOS_USE_TICKLESS_IDLE=y

# Enable FreeRTOS stats formatting functions, needed for 'tasks' command
CONFIG_FREERTOS_USE_TRACE_FACILITY=y
CONFIG_FREERTOS_USE_STATS_FORMATTING_FUNCTIONS=y

# UART configuration
CONFIG_UART_ISR_IN_IRAM=y
CONFIG_UART_USE_REFCOUNT=y

# Performance tracing and debug (optional, useful during early dev)
CONFIG_ESP_SYSTEM_MEMPROT_FEATURE=n
CONFIG_ESP_SYSTEM_PANIC_PRINT_HALT=n
CONFIG_LOG_DEFAULT_LEVEL_INFO=y
CONFIG_LOG_MAXIMUM_LEVEL=4

# Increase watchdog timeouts
CONFIG_ESP_TASK_WDT_TIMEOUT_S=10
```
